## debug/debug_memory_defconfig
```kconfig
CONFIG_SOFTLOCKUP_DETECTOR=y
CONFIG_BOOTPARAM_SOFTLOCKUP_PANIC=y
CONFIG_HARDLOCKUP_DETECTOR_OTHER_CPU=y
CONFIG_BOOTPARAM_HARDLOCKUP_PANIC=y
CONFIG_DETECT_HUNG_TASK=y
CONFIG_BOOTPARAM_HUNG_TASK_PANIC=y
CONFIG_WQ_WATCHDOG=y
CONFIG_PANIC_ON_RT_THROTTLING=y
CONFIG_RCU_EQS_DEBUG=y
CONFIG_LOCK_STAT=y
CONFIG_DEVMEM=y
CONFIG_DEBUG_OBJECTS=y
CONFIG_DEBUG_OBJECTS_FREE=y
CONFIG_DEBUG_OBJECTS_TIMERS=y
CONFIG_DEBUG_OBJECTS_WORK=y
CONFIG_DEBUG_OBJECTS_RCU_HEAD=y
CONFIG_DEBUG_OBJECTS_PERCPU_COUNTER=y
CONFIG_DEBUG_VM=y
CONFIG_DEBUG_VM_VMACACHE=y
CONFIG_DEBUG_VM_RB=y
CONFIG_DEBUG_MEMORY_INIT=y
CONFIG_DEBUG_STACK_USAGE=y
CONFIG_DEBUG_PAGEALLOC=y
CONFIG_DEBUG_PAGEALLOC_ENABLE_DEFAULT=y
CONFIG_SCHED_STACK_END_CHECK=y
CONFIG_SLUB_DEBUG=y
CONFIG_SLUB_DEBUG_PANIC_ON=y
CONFIG_PAGE_OWNER=y
CONFIG_PAGE_OWNER_ENABLE_DEFAULT=y
CONFIG_PAGE_POISONING=y
CONFIG_PAGE_POISONING_ENABLE_DEFAULT=y
CONFIG_DEBUG_RT_MUTEXES=y
CONFIG_DEBUG_SPINLOCK=y
CONFIG_DEBUG_SPINLOCK_PANIC_ON_BUG=y
CONFIG_DEBUG_MUTEXES=y
CONFIG_DEBUG_PREEMPT=y
CONFIG_DEBUG_ATOMIC_SLEEP=y
CONFIG_DEBUG_LIST=y
CONFIG_PANIC_ON_DATA_CORRUPTION=y
CONFIG_REGMAP_ALLOW_WRITE_DEBUGFS=y
# CONFIG_SHADOW_CALL_STACK is not set
```

## raviole_defconfig
```kconfig
# CONFIG_MODULE_SIG_ALL is not set
# CONFIG_ZRAM is not set
CONFIG_VH_FS=m
CONFIG_LOG_BUF_SHIFT=22
CONFIG_SOC_GOOGLE=y
CONFIG_SOC_GS101=y
CONFIG_BOARD_SLIDER=y
CONFIG_TRUSTY=m
CONFIG_TRUSTY_DMA_BUF_FFA_TAG=y
CONFIG_TRUSTY_CRASH_IS_PANIC=y
CONFIG_GS_CHIPID=m
CONFIG_SERIAL_EXYNOS=m
CONFIG_I2C_CHARDEV=m
CONFIG_I2C_EXYNOS5_GS=m
CONFIG_PINCTRL_EXYNOS_GS=m
CONFIG_PIXEL_POWER_REBOOT=m
CONFIG_S3C2410_WATCHDOG_GS=m
CONFIG_S3C2410_SHUTDOWN_REBOOT=y
CONFIG_CLKSRC_EXYNOS_MCT_GS=m
CONFIG_EXYNOS_GS_COMMON_CLK=m
CONFIG_CAL_IF=m
CONFIG_GS_ACPM=m
CONFIG_I2C_ACPM=m
CONFIG_EXYNOS_PMU_IF=m
CONFIG_EXYNOS_PD=m
CONFIG_EXYNOS_PD_DBG=m
CONFIG_EXYNOS_PD_HSI0=m
CONFIG_EXYNOS_PM=m
CONFIG_EXYNOS_CPUHP=m
CONFIG_EXYNOS_CPUPM=m
CONFIG_SPI_SPIDEV=m
CONFIG_SPI_S3C64XX_GS=m
CONFIG_ECT=m
CONFIG_ARM_EXYNOS_ACME=m
CONFIG_CHR_DEV_SG=m
CONFIG_SCSI_UFS_EXYNOS_GS=m
CONFIG_SCSI_UFS_CRYPTO_SW_KEYS_MODE=y
CONFIG_SCSI_UFS_PIXEL_FIPS140=m
CONFIG_SAMSUNG_IOMMU=m
CONFIG_DMABUF_SAMSUNG_HEAPS=m
CONFIG_DMABUF_HEAPS_SAMSUNG_CMA=y
CONFIG_DMABUF_HEAPS_SAMSUNG_CARVEOUT=y
CONFIG_DMABUF_HEAPS_SAMSUNG_SYSTEM=y
CONFIG_DMABUF_HEAPS_SAMSUNG_CHUNK=y
CONFIG_USB_DWC3_EXYNOS_GS=m
CONFIG_USB_XHCI_EXYNOS=m
CONFIG_USB_CONFIGFS_F_DM=m
CONFIG_INPUT_KEYCOMBO=m
CONFIG_INPUT_KEYDEBUG=m
CONFIG_KERNEL_TOP=m
CONFIG_INPUT_STMVL53L1=m
CONFIG_PHY_EXYNOS_USBDRD=m
CONFIG_PHY_SAMSUNG_USB_GEN2_V4=y
CONFIG_SAMSUNG_DMADEV=m
CONFIG_EXYNOS_DVFS_MANAGER=m
CONFIG_ACPM_DVFS=m
CONFIG_EXYNOS_PM_QOS=m
CONFIG_ARM_EXYNOS_DEVFREQ=m
CONFIG_MFD_S2MPG10=m
CONFIG_MFD_S2MPG11=m
CONFIG_MFD_S2MPG1X_GPIO=m
CONFIG_DRM_PANEL_BOE_NT37290=m
CONFIG_DRM_PANEL_GOOGLE_COMMON=m
CONFIG_DRM_PANEL_SAMSUNG_COMMON=m
CONFIG_DRM_PANEL_SAMSUNG_EMUL=m
CONFIG_DRM_PANEL_SAMSUNG_S6E3FC3=m
CONFIG_DRM_PANEL_SAMSUNG_S6E3FC3_P10=m
CONFIG_DRM_PANEL_SAMSUNG_S6E3HC2=m
CONFIG_DRM_PANEL_SAMSUNG_S6E3HC3=m
CONFIG_DRM_PANEL_SAMSUNG_S6E3HC3_C10=m
CONFIG_DRM_PANEL_SAMSUNG_S6E3HC4=m
CONFIG_DRM_PANEL_SAMSUNG_SOFEF01=m
CONFIG_DRM_SAMSUNG=m
CONFIG_QUEUE_DDIC_CMD_CALL_BACK=y
CONFIG_DRM_SAMSUNG_DP=y
CONFIG_DRM_SAMSUNG_DPP=y
CONFIG_DRM_SAMSUNG_DP_AUDIO=y
CONFIG_GS_DRM_PANEL_UNIFIED=m
CONFIG_DRV_SAMSUNG_PMIC=m
CONFIG_REGULATOR_S2MPG10=m
CONFIG_REGULATOR_S2MPG11=m
CONFIG_POWERMETER_S2MPG10=m
CONFIG_POWERMETER_S2MPG11=m
CONFIG_RTC_DRV_S2MPG10=m
CONFIG_GSC_TPM=m
CONFIG_GOOGLE_LOGBUFFER=m
CONFIG_GOOGLE_VOTABLE=m
CONFIG_EXYNOS_GRAPHICS_G2D=m
CONFIG_PHY_EXYNOS_MIPI_DSIM=m
CONFIG_PCI_EXYNOS_GS=m
CONFIG_PCI_EXYNOS_CAL_GS101=m
CONFIG_SHM_IPC=m
CONFIG_EXYNOS_DIT=m
CONFIG_EXYNOS_MODEM_IF=m
CONFIG_SEC_MODEM_S5100=m
CONFIG_CP_PKTPROC=m
CONFIG_CP_PKTPROC_UL=m
CONFIG_CPIF_TP_MONITOR=m
CONFIG_BOOT_DEVICE_SPI=m
CONFIG_LINK_DEVICE_PCIE_GPIO_WA=y
CONFIG_CP_WRESET_WA=y
CONFIG_CP_THERMAL=m
CONFIG_CPIF_AP_SUSPEND_DURING_VOICE_CALL=y
CONFIG_CH_EXTENSION=m
CONFIG_MODEM_IF_QOS=m
CONFIG_VIDEO_EXYNOS_MFC=m
CONFIG_EXYNOS_BTS=m
CONFIG_GSA=m
CONFIG_GSA_GSC=m
CONFIG_GS_S2MPU=m
CONFIG_SLC_PARTITION_MANAGER=m
CONFIG_GS_SLC_ACPM=m
CONFIG_SLC_PMON=y
CONFIG_PIXEL_EM=m
CONFIG_ACPM_FLEXPMU_DBG=m
CONFIG_ACPM_POWER_STATS=m
CONFIG_ACPM_MBOX_TEST=m
CONFIG_TYPEC_FUSB307=m
CONFIG_TYPEC_MAX77759=m
CONFIG_TYPEC_MAX77759_CONTAMINANT=m
CONFIG_TYPEC_MAX77779_CONTAMINANT=m
CONFIG_GS_THERMAL_V3=m
CONFIG_EXYNOS_ACPM_THERMAL=m
CONFIG_LINK_DEVICE_PCIE_IOCC=y
CONFIG_EXYNOS_CPU_THERMAL=m
CONFIG_GPU_THERMAL=m
CONFIG_ISP_THERMAL=m
CONFIG_SBB_MUX=m
CONFIG_GPIOLIB=y
CONFIG_VIDEO_EXYNOS_SMFC=m
CONFIG_MFD_SLG51000=m
CONFIG_REGULATOR_SLG51000_GS=m
CONFIG_PINCTRL_SLG51000=m
CONFIG_PHY_EXYNOS_MIPI=m
CONFIG_REGULATOR_MAX77826_GS=m
CONFIG_SUBSYSTEM_COREDUMP=m
CONFIG_GSOC_PMIC_THERMAL=m
CONFIG_DEBUG_REBOOT=m
CONFIG_DEBUG_SNAPSHOT=m
CONFIG_DEBUG_SNAPSHOT_SFRDUMP=m
CONFIG_DEBUG_SNAPSHOT_QUICKDUMP=m
CONFIG_DEBUG_SNAPSHOT_DEBUG_KINFO=m
CONFIG_GOOGLE_BCL=m
CONFIG_GOOGLE_EH=m
CONFIG_ZSMALLOC=m
CONFIG_ZRAM_GS=m
CONFIG_ZCOMP_CPU=m
CONFIG_ZCOMP_EH=m
CONFIG_ZRAM_WRITEBACK=y
CONFIG_EXYNOS_DEBUG_TEST=m
CONFIG_PIXEL_DEBUG_TEST=m
CONFIG_PIXEL_BOOT_METRICS=m
CONFIG_PIXEL_SUSPEND_DIAG=m
CONFIG_HARDLOCKUP_DEBUG=m
CONFIG_HARDLOCKUP_WATCHDOG=m
CONFIG_ODPM=m
CONFIG_EXYNOS_ITMON=m
CONFIG_EEPROM_AT24=m
CONFIG_ARM_DSU_PMU=m
CONFIG_GOODIX_FINGERPRINT=m
CONFIG_EXYNOS_CORESIGHT=m
CONFIG_EXYNOS_ECC_HANDLER=m
CONFIG_NET_PKTGEN=m
CONFIG_EXYNOS_CORESIGHT_ETM=m
CONFIG_EXYNOS_CORESIGHT_ETF=y
CONFIG_EXYNOS_CORESIGHT_ETR=y
CONFIG_EXYNOS_ADV_TRACER=m
CONFIG_EXYNOS_ADV_TRACER_S2D=m
CONFIG_EXYNOS_EHLD=m
CONFIG_EXYNOS_ALT_DVFS=m
CONFIG_DBGCORE_DUMP=m
CONFIG_GS_SJTAG=m
CONFIG_EXYNOS_BCM_DBG=m
CONFIG_EXYNOS_BCM_DBG_DUMP=m
CONFIG_EXYNOS_SECURE_LOG=m
CONFIG_HW_RANDOM_EXYNOS_SWD=m
CONFIG_EXYNOS_CONTENT_PATH_PROTECTION=m
CONFIG_EXYNOS_BCM_DBG_PPMU=y
CONFIG_USB_CONFIGFS_F_ETR_MIU=m
CONFIG_IEEE802154_NL802154_EXPERIMENTAL=y
CONFIG_SOFT_WATCHDOG=m
CONFIG_PIXEL_STAT=m
# CONFIG_ARM_MEMLAT_MON is not set
# CONFIG_DEVFREQ_GOV_MEMLAT is not set
# CONFIG_MEMLAT_DEVFREQ is not set
CONFIG_TICK_DRIVEN_LATGOV=y
CONFIG_GS_PERF_MON=m
CONFIG_GS_MEMLAT_GOVERNOR=m
CONFIG_TYPEC_COOLING_DEV=m
CONFIG_SYSRQ_HOOK=m
CONFIG_BOOT_CONTROL=m
CONFIG_TOUCHSCREEN_TBN=m
CONFIG_TOUCHSCREEN_HEATMAP=m
CONFIG_TOUCHSCREEN_OFFLOAD=m
CONFIG_TOUCHSCREEN_SEC_TS=m
CONFIG_TOUCHSCREEN_FTS=m
CONFIG_GOOG_TOUCH_INTERFACE=m
CONFIG_VH_SCHED_MAX_CPU_NR=8
CONFIG_VH_SCHED=m
CONFIG_VH_CGROUP=m
CONFIG_VH_THERMAL=m
CONFIG_VH_MM=m
CONFIG_VH_SYSTRACE=m
CONFIG_VH_PREEMPTIRQ_TRACEPOINTS=m
CONFIG_PIXEL_METRICS=m
# CFG80211 & MAC80211 as modules
CONFIG_CFG80211=m
CONFIG_NL80211_TESTMODE=y
# CONFIG_CFG80211_DEFAULT_PS is not set
# CONFIG_CFG80211_CRDA_SUPPORT is not set
CONFIG_MAC80211=m
CONFIG_RADIO_S5300=y
```
